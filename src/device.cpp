
// Generated by slyft.io
// This code part has been generated on an "as is" basis, without warranties or conditions of any kind.


#include "Arduino.h"

#include "device.h"
#include "mpack/mpack.h"
#include "mpack/mpack-platform.h"

void TUT__device_clean(struct TUT__device *self) {

	self->led = 0;
	self->poti = 0;
}

void TUT__device_parse_next(struct TUT__device *self, mpack_reader_t *reader) {

	char	buf_key[5];
	mpack_expect_utf8_cstr(reader, buf_key, sizeof(buf_key));


	if (mpack_memcmp("led",(const char*)buf_key,3) == 0) {
		self->led = mpack_expect_i32(reader);
	}

	if (mpack_memcmp("poti",(const char*)buf_key,4) == 0) {
		self->poti = mpack_expect_i32(reader);
	}


}

int TUT__device_parse(struct TUT__device *self, const uint8_t *input_buf, size_t sz_input_buf) {
		mpack_reader_t reader;
    mpack_error_t error;

    mpack_reader_init_data(&reader,(const char *)input_buf, sz_input_buf);
    self->TUT__device_parse_mpack(self, &reader);

    error = mpack_reader_destroy(&reader);
    if ( error != mpack_ok) {
        return 1;
    } else {
        return 0;
    }

}

void TUT__device_parse_mpack(struct TUT__device *self, mpack_reader_t *reader) {

    int count = mpack_expect_map_range(reader, 0, 2);
    for (int i = 0; i < count; i++) {
        TUT__device_parse_next(self, reader);
    }

    mpack_done_map(reader);
}

size_t TUT__device_serialize(const struct TUT__device *self, uint8_t *output_buf, size_t sz_output_buf) {
		struct mpack_writer_t writer;
    mpack_writer_init(&writer,(char*)output_buf,sz_output_buf);

		self->TUT__device_serialize_mpack(self, &writer);

    size_t used = mpack_writer_buffer_used(&writer);

    // if all is ok, return length of used bytes. Otherwise 0
    if (mpack_writer_destroy(&writer) == mpack_ok) {
        return used;
    } else {
        return (size_t)0;
    }
}

void TUT__device_serialize_mpack(const struct TUT__device *self, mpack_writer_t *writer) {
    mpack_start_map(writer, 2);

	mpack_write_cstr(writer, "led"); mpack_write_i32(writer, self->led);
	mpack_write_cstr(writer, "poti"); mpack_write_i32(writer, self->poti);

    mpack_finish_map(writer);
}

void TUT__device_init(struct TUT__device *self) {
    self->TUT__device_clean = &TUT__device_clean;
    self->TUT__device_parse = &TUT__device_parse;
    self->TUT__device_parse_mpack = &TUT__device_parse_mpack;
    self->TUT__device_serialize = &TUT__device_serialize;
    self->TUT__device_serialize_mpack = &TUT__device_serialize_mpack;
    self->TUT__device_clean(self);
}

//
